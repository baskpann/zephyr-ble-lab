## CMakeLists.txt
```
# SPDX-License-Identifier: Apache-2.0

cmake_minimum_required(VERSION 3.20.0)

find_package(Zephyr REQUIRED HINTS $ENV{ZEPHYR_BASE})
project(host_bt_shell)

target_sources(app PRIVATE src/main.c)
```

## prj.conf
```kconfig
CONFIG_BT=y
CONFIG_BT_HCI=y

CONFIG_BT_SHELL=y

CONFIG_BT_DRIVERS=y
CONFIG_BT_H4=y
```

## boards/stm32f4_disco.overlay
```dts
/* SPDX-License-Identifier: Apache-2.0 */

/ {
	chosen {
		zephyr,bt-hci = &bt_hci_uart;
	};
};

&usart3 {
	pinctrl-0 = <&usart3_tx_pb10 &usart3_rx_pb11
			&usart3_cts_pb13 &usart3_rts_pb14>;
	pinctrl-names = "default";
	current-speed = <115200>;
	status = "okay";

	bt_hci_uart: bt_hci_uart {
		compatible = "zephyr,bt-hci-uart";
		status = "okay";
	};
};
```

## src/main.c
```c
/*
 * 00-hci-bringup — Host application
 *
 * Purpose: prove the STM32F4 Host <-> nRF52840 Controller HCI UART link
 * works, driven manually from the Zephyr shell (CONFIG_BT_SHELL=y).
 *
 * Deliberately does NOT call bt_enable() itself — with CONFIG_BT_SHELL,
 * the "bt init" shell command calls bt_enable() for you. Leaving init to
 * the shell means you drive each step by hand (bt init -> bt adv on)
 */

#include <zephyr/kernel.h>
#include <zephyr/logging/log.h>

LOG_MODULE_REGISTER(hci_bringup, LOG_LEVEL_INF);

int main(void)
{
	LOG_INF("Host app booted. Use shell: 'bt init' then 'bt scan on'.");
	return 0;
}
```
